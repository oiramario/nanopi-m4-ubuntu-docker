## boot/rk3399-fit.its
```
/dts-v1/;
  
/ {
    description = "U-Boot fitImage for rk3399_aarch64 kernel";
    #address-cells = <1>;
  
    images {
		kernel {
            description = "kernel aarch64 4.4.y";
            data = /incbin/("./Image.gz");
            type = "kernel";
            arch = "arm64";
            os = "linux";
			compression = "gzip";
			load = <0x00080000>;
			entry = <0x00080000>;
			hash_crc {
				algo = "crc32";
			};
		};

        initramfs {
            description = "busybox ramdisk";
            data = /incbin/("./initramfs.cpio.gz");
            type = "ramdisk";
            arch = "arm64";
            os = "linux";
			compression = "gzip";
			load = <0x01400000>;
			entry = <0x01400000>;
			hash_crc {
				algo = "crc32";
			};
        };

        fdt_t4 {
            description = "nanopc-t4 fdt";
            data = /incbin/("./rk3399-nanopi4-rev00.dtb");
            type = "flat_dt";
            arch = "arm64";
			compression = "none";
			load = <0x01700000>;
			hash_crc {
				algo = "crc32";
			};
        };

        fdt_m4 {
            description = "nanopi-m4 fdt";
            data = /incbin/("./rk3399-nanopi4-rev01.dtb");
            type = "flat_dt";
            arch = "arm64";
			compression = "none";
			load = <0x01700000>;
			hash_crc {
				algo = "crc32";
			};
        };

        fdt_neo4 {
            description = "nanopi-neo4 fdt";
            data = /incbin/("./rk3399-nanopi4-rev04.dtb");
            type = "flat_dt";
            arch = "arm64";
            compression = "none";
			load = <0x01700000>;
			hash_crc {
				algo = "crc32";
			};
        };

        fdt_rock64 {
            description = "nanopi-rock64 fdt";
            data = /incbin/("./rk3399-nanopi4-rev06.dtb");
            type = "flat_dt";
            arch = "arm64";
			compression = "none";
			load = <0x01700000>;
			hash_crc {
				algo = "crc32";
			};
        };
    };

    configurations {
        default = "conf_m4";

        conf_t4 {
            description = "nanopc-t4";
            kernel = "kernel";
            ramdisk = "initramfs";
            fdt = "fdt_t4";
        };

        conf_m4 {
            description = "nanopi-m4";
            kernel = "kernel";
            ramdisk = "initramfs";
            fdt = "fdt_m4";
        };

        conf_neo4 {
            description = "nanopi-neo4";
            kernel = "kernel";
            ramdisk = "initramfs";
            fdt = "fdt_neo4";
        };

        conf_rock64 {
            description = "nanopi-rock64";
            kernel = "kernel";
            ramdisk = "initramfs";
            fdt = "fdt_rock64";
        };
    };
};
```

## boot/rk3399.its
```
/dts-v1/;
  
/ {
    description = "U-Boot fitImage for rk3399_aarch64 kernel";
    #address-cells = <1>;
  
    images {
		kernel {
            description = "Linux Kernel";
            data = /incbin/("./Image.gz");
            type = "kernel";
            arch = "arm64";
            os = "linux";
			compression = "gzip";
			load = <0x00080000>;
			entry = <0x00080000>;
			hash_crc {
				algo = "crc32";
			};
		};

        initrd {
            description = "initrd";
            data = /incbin/("./initrd.cpio.gz");
            type = "ramdisk";
            arch = "arm64";
            os = "linux";
			compression = "gzip";
			load = <0x01400000>;
			entry = <0x01400000>;
			hash_crc {
				algo = "crc32";
			};
        };

        fdt_t4 {
            description = "nanopc-t4";
            data = /incbin/("./rk3399-nanopi4-rev00.dtb");
            type = "flat_dt";
            arch = "arm64";
            compression = "none";
			hash_crc {
				algo = "crc32";
			};
        };

        fdt_m4 {
            description = "nanopi-m4";
            data = /incbin/("./rk3399-nanopi4-rev01.dtb");
            type = "flat_dt";
            arch = "arm64";
            compression = "none";
			hash_crc {
				algo = "crc32";
			};
        };

        fdt_neo4 {
            description = "nanopi-neo4";
            data = /incbin/("./rk3399-nanopi4-rev04.dtb");
            type = "flat_dt";
            arch = "arm64";
            compression = "none";
			hash_crc {
				algo = "crc32";
			};
        };

        fdt_rock64 {
            description = "nanopi-rock64";
            data = /incbin/("./rk3399-nanopi4-rev06.dtb");
            type = "flat_dt";
            arch = "arm64";
            compression = "none";
			hash_crc {
				algo = "crc32";
			};
        };
    };

    configurations {
        default = "conf_m4";

        conf_t4 {
            description = "nanopc-t4 kernel4.4.y";
            kernel = "kernel";
            fdt = "fdt_t4";
            ramdisk = "initrd";
        };

        conf_m4 {
            description = "nanopi-m4 kernel4.4.y";
            kernel = "kernel";
            fdt = "fdt_m4";
            ramdisk = "initrd";
        };

        conf_neo4 {
            description = "nanopi-neo4 kernel4.4.y(compressed)";
            kernel = "kernel";
            fdt = "fdt_neo4";
            ramdisk = "initrd";
        };

        conf_rock64 {
            description = "nanopi-rock64 kernel4.4.y(compressed)";
            kernel = "kernel";
            fdt = "fdt_rock64";
            ramdisk = "initrd";
        };
    };
};
```

## scripts/boot/boot.its
```
/dts-v1/;
 
/ {
    description = "boot script uImage";
    images {
         default = "script";
         script {
             description = "boot script";
             data = /incbin/("./boot.script");
             type = "script";
             compression = "none";
        };
    };
};
```

## scripts/boot/fitImage.its
```
/dts-v1/;
  
/ {
    description = "U-Boot fitImage for rk3399_aarch64 kernel";
    #address-cells = <1>;
  
    images {
		kernel {
            description = "kernel 4.4.y";
            data = /incbin/("./kernel.gz");
            type = "kernel";
            arch = "arm64";
            os = "linux";
			compression = "gzip";
			load = <0x02080000>;
			entry = <0x02080000>;
			hash_crc {
				algo = "crc32";
			};
		};

        fdt_m4 {
            description = "nanopi-m4";
            data = /incbin/("./rk3399-nanopi4-rev01.dtb");
            type = "flat_dt";
            arch = "arm64";
			compression = "none";
			load = <0x01f00000>;
			hash_crc {
				algo = "crc32";
			};
        };

        initramfs {
            description = "busybox";
            data = /incbin/("./ramdisk.cpio.gz");
            type = "ramdisk";
            arch = "arm64";
            os = "linux";
			compression = "gzip";
			load = <0x06000000>;
			entry = <0x06000000>;
			hash_crc {
				algo = "crc32";
			};
        };
    };

    configurations {
        default = "conf_m4";

        conf_m4 {
            description = "nanopi-m4";
            kernel = "kernel";
            ramdisk = "initramfs";
            fdt = "fdt_m4";
        };
    };
};
```

## scripts/boot/nanopi-m4.its
```
/dts-v1/;
  
/ {
    description = "nanopi-m4 boot uImage";
    #address-cells = <1>;
  
    images {
		kernel {
            description = "kernel 4.4.y";
            data = /incbin/("./kernel.gz");
            type = "kernel";
            arch = "arm64";
            os = "linux";
			compression = "gzip";
			load = <0x02080000>;
			entry = <0x02080000>;
		};

        fdt_m4 {
            description = "nanopi-m4";
            data = /incbin/("./rk3399-nanopi-m4.dtb");
            type = "flat_dt";
            arch = "arm64";
			compression = "none";
			load = <0x01f00000>;
        };

        initramfs {
            description = "busybox";
            data = /incbin/("./ramdisk.cpio.gz");
            type = "ramdisk";
            arch = "arm64";
            os = "linux";
			compression = "none";
			load = <0x06000000>;
			entry = <0x06000000>;
        };
    };

    configurations {
        default = "conf_m4";
        conf_m4 {
            description = "nanopi-m4";
            kernel = "kernel";
            ramdisk = "initramfs";
            fdt = "fdt_m4";
        };
    };
};
```

## scripts/boot/nanopi4.its
```
/dts-v1/;
  
/ {
    description = "nanopi4 boot uImage";
    #address-cells = <1>;
  
    images {
		kernel {
            description = "kernel 4.4.y";
            data = /incbin/("./kernel.lz4");
            type = "kernel";
            arch = "arm64";
            os = "linux";
			compression = "lz4";
			load = <0x02080000>;
			entry = <0x02080000>;
		};

        fdt_t4 {
            description = "nanopc-t4";
            data = /incbin/("./rk3399-nanopi4-rev00.dtb");
            type = "flat_dt";
            arch = "arm64";
			compression = "none";
			load = <0x01f00000>;
        };

        fdt_m4 {
            description = "nanopi-m4";
            data = /incbin/("./rk3399-nanopi4-rev01.dtb");
            type = "flat_dt";
            arch = "arm64";
			compression = "none";
			load = <0x01f00000>;
        };

        fdt_neo4 {
            description = "nanopi-neo4";
            data = /incbin/("./rk3399-nanopi4-rev04.dtb");
            type = "flat_dt";
            arch = "arm64";
            compression = "none";
			load = <0x01f00000>;
        };

        initramfs {
            description = "busybox";
            data = /incbin/("./ramdisk.cpio.gz");
            type = "ramdisk";
            arch = "arm64";
            os = "linux";
			compression = "none";
			load = <0x06000000>;
			entry = <0x06000000>;
        };
    };

    configurations {
        default = "conf_m4";
        
        conf_t4 {
            description = "nanopc-t4";
            kernel = "kernel";
            ramdisk = "initramfs";
            fdt = "fdt_t4";
        };

        conf_m4 {
            description = "nanopi-m4";
            kernel = "kernel";
            ramdisk = "initramfs";
            fdt = "fdt_m4";
        };

        conf_neo4 {
            description = "nanopi-neo4";
            kernel = "kernel";
            ramdisk = "initramfs";
            fdt = "fdt_neo4";
        };
    };
};
```

## scripts/boot/qemu_fitImage.its
```
/dts-v1/;
  
/ {
    description = "U-Boot fitImage for rk3399_aarch64 kernel";
    #address-cells = <1>;
  
    images {
		kernel {
            description = "kernel 4.4.y";
            data = /incbin/("./kernel.gz");
            type = "kernel";
            arch = "arm64";
            os = "linux";
			compression = "gzip";
			load = <0x80080000>;
			entry = <0x80080000>;
			hash_crc {
				algo = "crc32";
			};
		};

        fdt_m4 {
            description = "nanopi-m4";
            data = /incbin/("./rk3399-nanopi4-rev01.dtb");
            type = "flat_dt";
            arch = "arm64";
			compression = "none";
			hash_crc {
				algo = "crc32";
			};
        };
    };

    configurations {
        default = "conf_m4";

        conf_m4 {
            description = "nanopi-m4";
            kernel = "kernel";
            fdt = "fdt_m4";
        };
    };
};
```
